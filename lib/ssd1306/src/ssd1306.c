#include "ssd1306.h"
#include "stm32f4xx_hal.h"

uint8_t SSD1306_Buffer[SSD1306_WIDTH * SSD1306_HEIGHT / 8];

static const uint8_t Font_5x7_data[] = {
    0x00, 0x00, 0x00, 0x00, 0x00, // space
    0x00, 0x00, 0x5F, 0x00, 0x00, // !
    0x00, 0x07, 0x00, 0x07, 0x00, // "
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    0x08, 0x04, 0x08, 0x10, 0x08, // ~
};

FontDef Font_5x7 = { Font_5x7_data, 5, 7 };
FontDef Font_7x10 = { Font_5x7_data, 5, 7 };
FontDef Font_11x18 = { Font_5x7_data, 5, 7 };

static void ssd1306_WriteCommand(SSD1306_t *dev, uint8_t cmd) {
    uint8_t buf[2] = { 0x00, cmd };
    HAL_I2C_Master_Transmit(dev->I2C_Handle, dev->Address << 1, buf, 2, 100);
}

static void ssd1306_WriteData(SSD1306_t *dev, uint8_t *data, uint16_t len) {
    uint8_t buf[SSD1306_WIDTH + 1];
    buf[0] = 0x40;
    memcpy(buf + 1, data, len);
    HAL_I2C_Master_Transmit(dev->I2C_Handle, dev->Address << 1, buf, len + 1, 100);
}

HAL_StatusTypeDef ssd1306_Init(SSD1306_t *dev, I2C_HandleTypeDef *i2c, uint8_t addr, uint8_t width, uint8_t height) {
    dev->I2C_Handle = i2c;
    dev->Address = addr;
    dev->Width = width;
    dev->Height = height;
    dev->CurrentX = 0;
    dev->CurrentY = 0;
    dev->Inverted = 0;
    dev->Initialized = 0;

    HAL_Delay(100);

    if (HAL_I2C_IsDeviceReady(i2c, addr << 1, 1, 100) != HAL_OK) {
        return HAL_ERROR;
    }

    ssd1306_WriteCommand(dev, 0xAE);
    ssd1306_WriteCommand(dev, 0xD5); ssd1306_WriteCommand(dev, 0x80);
    ssd1306_WriteCommand(dev, 0xA8); ssd1306_WriteCommand(dev, 0x3F);
    ssd1306_WriteCommand(dev, 0xD3); ssd1306_WriteCommand(dev, 0x00);
    ssd1306_WriteCommand(dev, 0x40);
    ssd1306_WriteCommand(dev, 0x8D); ssd1306_WriteCommand(dev, 0x14);
    ssd1306_WriteCommand(dev, 0x20); ssd1306_WriteCommand(dev, 0x00);
    ssd1306_WriteCommand(dev, 0xA1);
    ssd1306_WriteCommand(dev, 0xC8);
    ssd1306_WriteCommand(dev, 0xDA); ssd1306_WriteCommand(dev, 0x12);
    ssd1306_WriteCommand(dev, 0x81); ssd1306_WriteCommand(dev, 0xCF);
    ssd1306_WriteCommand(dev, 0xD9); ssd1306_WriteCommand(dev, 0xF1);
    ssd1306_WriteCommand(dev, 0xDB); ssd1306_WriteCommand(dev, 0x40);
    ssd1306_WriteCommand(dev, 0xA4);
    ssd1306_WriteCommand(dev, 0xA6);
    ssd1306_WriteCommand(dev, 0xAF);

    dev->Initialized = 1;
    ssd1306_Fill(dev, Black);
    ssd1306_UpdateScreen(dev);

    return HAL_OK;
}

void ssd1306_Fill(SSD1306_t *dev, SSD1306_COLOR color) {
    memset(SSD1306_Buffer, color ? 0xFF : 0x00, sizeof(SSD1306_Buffer));
}

void ssd1306_UpdateScreen(SSD1306_t *dev) {
    for (uint8_t page = 0; page < 8; page++) {
        ssd1306_WriteCommand(dev, 0xB0 + page);
        ssd1306_WriteCommand(dev, 0x00);
        ssd1306_WriteCommand(dev, 0x10);
        ssd1306_WriteData(dev, &SSD1306_Buffer[page * 128], 128);
    }
}

void ssd1306_DrawPixel(SSD1306_t *dev, uint16_t x, uint16_t y, SSD1306_COLOR color) {
    if (x >= dev->Width || y >= dev->Height) return;
    if (color == White) SSD1306_Buffer[x + (y / 8) * dev->Width] |= 1 << (y % 8);
    else if (color == Black) SSD1306_Buffer[x + (y / 8) * dev->Width] &= ~(1 << (y % 8));
    else SSD1306_Buffer[x + (y / 8) * dev->Width] ^= 1 << (y % 8);
}

void ssd1306_SetCursor(SSD1306_t *dev, uint16_t x, uint16_t y) {
    dev->CurrentX = x;
    dev->CurrentY = y;
}

char ssd1306_WriteChar(SSD1306_t *dev, char ch, FontDef font, SSD1306_COLOR color) {
    if (ch < 32 || ch > 126) return 0;
    const uint8_t *glyph = font.data + (ch - 32) * font.width;
    for (uint16_t col = 0; col < font.width; col++) {
        uint8_t line = glyph[col];
        for (uint16_t row = 0; row < font.height; row++) {
            if (line & (1 << row)) {
                ssd1306_DrawPixel(dev, dev->CurrentX + col, dev->CurrentY + row, color);
            }
        }
    }
    dev->CurrentX += font.width + 1;
    return ch;
}

char ssd1306_WriteString(SSD1306_t *dev, char *str, FontDef font, SSD1306_COLOR color) {
    while (*str) {
        if (ssd1306_WriteChar(dev, *str, font, color) == 0) return *str;
        str++;
    }
    return *str;
}

void ssd1306_DrawLine(SSD1306_t *dev, uint16_t x1, uint16_t y1, uint16_t x2, uint16_t y2, SSD1306_COLOR color) {
    int16_t dx = abs(x2 - x1), sx = x1 < x2 ? 1 : -1;
    int16_t dy = -abs(y2 - y1), sy = y1 < y2 ? 1 : -1;
    int16_t err = dx + dy, e2;
    while (1) {
        ssd1306_DrawPixel(dev, x1, y1, color);
        if (x1 == x2 && y1 == y2) break;
        e2 = 2 * err;
        if (e2 >= dy) { err += dy; x1 += sx; }
        if (e2 <= dx) { err += dx; y1 += sy; }
    }
}

void ssd1306_DrawRectangle(SSD1306_t *dev, uint16_t x1, uint16_t y1, uint16_t x2, uint16_t y2, SSD1306_COLOR color) {
    ssd1306_DrawLine(dev, x1, y1, x2, y1, color);
    ssd1306_DrawLine(dev, x2, y1, x2, y2, color);
    ssd1306_DrawLine(dev, x2, y2, x1, y2, color);
    ssd1306_DrawLine(dev, x1, y2, x1, y1, color);
}

void ssd1306_FillRectangle(SSD1306_t *dev, uint16_t x1, uint16_t y1, uint16_t x2, uint16_t y2, SSD1306_COLOR color) {
    for (uint16_t y = y1; y <= y2; y++)
        for (uint16_t x = x1; x <= x2; x++)
            ssd1306_DrawPixel(dev, x, y, color);
}

void ssd1306_DrawCircle(SSD1306_t *dev, uint16_t x0, uint16_t y0, uint16_t r, SSD1306_COLOR color) {
    int16_t x = r, y = 0, err = 0;
    while (x >= y) {
        ssd1306_DrawPixel(dev, x0 + x, y0 + y, color);
        ssd1306_DrawPixel(dev, x0 + y, y0 + x, color);
        ssd1306_DrawPixel(dev, x0 - y, y0 + x, color);
        ssd1306_DrawPixel(dev, x0 - x, y0 + y, color);
        ssd1306_DrawPixel(dev, x0 - x, y0 - y, color);
        ssd1306_DrawPixel(dev, x0 - y, y0 - x, color);
        ssd1306_DrawPixel(dev, x0 + y, y0 - x, color);
        ssd1306_DrawPixel(dev, x0 + x, y0 - y, color);
        y++;
        err += 1 + 2*y;
        if (2*(err-x) + 1 > 0) { x--; err += 1 - 2*x; }
    }
}

void ssd1306_FillCircle(SSD1306_t *dev, uint16_t x0, uint16_t y0, uint16_t r, SSD1306_COLOR color) {
    int16_t x = r, y = 0, err = 0;
    while (x >= y) {
        for (int16_t i = -x; i <= x; i++) ssd1306_DrawPixel(dev, x0 + i, y0 + y, color);
        for (int16_t i = -x; i <= x; i++) ssd1306_DrawPixel(dev, x0 + i, y0 - y, color);
        for (int16_t i = -y; i <= y; i++) ssd1306_DrawPixel(dev, x0 + i, y0 + x, color);
        for (int16_t i = -y; i <= y; i++) ssd1306_DrawPixel(dev, x0 + i, y0 - x, color);
        y++;
        err += 1 + 2*y;
        if (2*(err-x) + 1 > 0) { x--; err += 1 - 2*x; }
    }
}

void ssd1306_InvertDisplay(SSD1306_t *dev, uint8_t invert) {
    ssd1306_WriteCommand(dev, invert ? 0xA7 : 0xA6);
}

void ssd1306_SetContrast(SSD1306_t *dev, uint8_t contrast) {
    ssd1306_WriteCommand(dev, 0x81);
    ssd1306_WriteCommand(dev, contrast);
}